#include<MD_MAX72xx.h>
#include<SPI.h>

//Led_matrix setup
#define HARDWARE_TYPE MD_MAX72XX::FC16_HW
#define MAX_DEVICES 4
#define CS_PIN    8

MD_MAX72XX mx = MD_MAX72XX(HARDWARE_TYPE, CS_PIN, MAX_DEVICES);

//Button
const int CH1 = 5;
const int CH2 = 6;
const int CH3 = 4;
const int CH4 = 3;
const int CH5 = 2;

const unsigned int game_icon[3][16][2] = {0x00, 0x00, 0x00, 0x00, 0x00, 0x00, 0x00, 0x00, 0xF0, 0x0F, 0x10, 0x08, 0x10, 0x4F, 0x10, 0xC1, 0x08, 0x82, 0x08, 0x00, 0x08, 0x20, 0x08, 0x50, 0x00, 0x20, 0x00, 0x00, 0x00, 0x00, 0x00, 0x00,
                                           0x00, 0x00, 0x00, 0x00, 0x00, 0x00, 0x00, 0x00, 0x00, 0x00, 0x70, 0x08, 0x12, 0x49, 0x83, 0xCB, 0x40, 0x12, 0x06, 0xC0, 0x0C, 0xC0, 0x00, 0x00, 0x00, 0x00, 0x00, 0x00, 0x00, 0x00, 0x00, 0x00,                                 
                                           0x00, 0x00, 0x00, 0x00, 0x00, 0x00, 0x00, 0x00, 0x00, 0x00, 0xE0, 0x03, 0x1A, 0x0C, 0x1B, 0x12, 0x5C, 0x30, 0x0C, 0x20, 0x07, 0xC0, 0x00, 0x00, 0x00, 0x00, 0x00, 0x00, 0x00, 0x00, 0x00, 0x00};
int mode = 0;

void setup() {
  Serial.begin(9600);
  mx.begin();
  mx.control(MD_MAX72XX::INTENSITY, 0);
  mx.clear();
  pinMode(CH1, INPUT_PULLUP);
  pinMode(CH2, INPUT_PULLUP);
  pinMode(CH3, INPUT_PULLUP);
  pinMode(CH4, INPUT_PULLUP);
  pinMode(CH5, INPUT_PULLUP);
}

void loop() {
  if (digitalRead(CH1) == 0) {
    if (mode > 0) {
      mode--;
    }
  } else if (digitalRead(CH3) == 0) {
    if (mode < 2) {
      mode++;
    }
  }
  for (int j = 0; j < 50 ; j++) {
    for (int i = 0; i < 8; i++) {
      mx.setRow(0, 0, i, game_icon[mode][i + 8][1]);
      mx.setRow(1, 1, i, game_icon[mode][i + 8][0]);
      mx.setRow(3, 3, 7 - i, game_icon[mode][i][1]);
      mx.setRow(2, 2, 7 - i, game_icon[mode][i][0]);
    }
  }
}